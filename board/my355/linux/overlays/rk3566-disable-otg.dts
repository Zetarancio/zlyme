/dts-v1/;
/plugin/;

/* USB host (top port): EHCI fd800000 + OHCI fd840000.
 * Off saves power when no stick is needed. Bottom USB-C stays charge/gadget. */

/ {
	fragment@0 {
		target-path = "/usb@fd800000";
		__overlay__ {
			status = "disabled";
		};
	};
	fragment@1 {
		target-path = "/usb@fd840000";
		__overlay__ {
			status = "disabled";
		};
	};
};
