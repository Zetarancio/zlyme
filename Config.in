## package/boot/Config.in
```kconfig
source "$BR2_EXTERNAL_ZLYME_PATH/package/boot/zlyme-initramfs/Config.in"
source "$BR2_EXTERNAL_ZLYME_PATH/package/boot/my355-fw-installer/Config.in"
```

## package/boot/my355-fw-installer/Config.in
```kconfig
config BR2_PACKAGE_MY355_FW_INSTALLER
	bool "my355 stock preloader installer image"
	default y if BR2_ZLYME_DEVICE_MY355
	help
	  Build miyoo355_fw.img from a pinned apommel/baseos-my355
	  revision. Stock firmware runs this installer. It is not a
	  preloader binary and it is not installed into the rootfs.
```

## package/boot/zlyme-initramfs/Config.in
```kconfig
config BR2_PACKAGE_ZLYME_INITRAMFS
	bool "zlyme-initramfs"
	select BR2_PACKAGE_LIBXCRYPT
	default n
	help
	  Tiny static busybox initramfs. Embedded in the kernel Image.
	  Mounts the primary boot and storage partitions after checking
	  their labels, copies pending/zlyme
	  over the live FAT file if present, loop-mounts zlyme, then
	  switch_root.

	  Harvested from Knulli knulli-initramfs (busybox 1.36.1).

	  http://busybox.net/
```

## package/drivers/Config.in
```kconfig
# Out-of-tree kernel drivers.
source "$BR2_EXTERNAL_ZLYME_PATH/package/drivers/rtl8733bu/Config.in"
source "$BR2_EXTERNAL_ZLYME_PATH/package/drivers/rtl8733bu-power/Config.in"
source "$BR2_EXTERNAL_ZLYME_PATH/package/drivers/rtl8723fu-firmware/Config.in"
source "$BR2_EXTERNAL_ZLYME_PATH/package/drivers/rocknix-joypad/Config.in"
source "$BR2_EXTERNAL_ZLYME_PATH/package/drivers/mali-kbase/Config.in"
```

## package/drivers/mali-kbase/Config.in
```kconfig
config BR2_PACKAGE_MALI_KBASE
	bool "mali-kbase"
	depends on BR2_LINUX_KERNEL
	help
	  ARM Mali Bifrost kernel driver (mali_kbase.ko) from
	  https://github.com/rocknix/mali_kbase, platform=devicetree.
	  Cannot bind at the same time as panfrost; gpudriver picks one.

	  https://github.com/rocknix/mali_kbase
```

## package/drivers/miyoo-flip-gamepad/Config.in
```kconfig
config BR2_PACKAGE_MIYOO_FLIP_GAMEPAD
	bool "miyoo-flip-gamepad"
	depends on BR2_ZLYME_DEVICE_MY355
	depends on BR2_LINUX_KERNEL
	help
	  Miyoo Flip gamepad tracer. UART1 serdev axes, GPIO-irq
	  buttons, one input device named "Miyoo Flip Gamepad".

comment "miyoo-flip-gamepad needs the Miyoo Flip target and a kernel"
	depends on !BR2_ZLYME_DEVICE_MY355 || !BR2_LINUX_KERNEL
```

## package/drivers/rk3568-dmc/Config.in
```kconfig
config BR2_PACKAGE_RK3568_DMC
	bool "rk3568-dmc"
	depends on BR2_ZLYME_DEVICE_MY355
	depends on BR2_LINUX_KERNEL
	help
	  RK3566/RK3568 DMC devfreq module for the Miyoo Flip.
	  DDR scaling uses the ATF shared-memory SIP protocol.
	  The Flip DTS compatible rockchip,rk3568-dmc autoloads it.

comment "rk3568-dmc needs the Miyoo Flip target and a kernel"
	depends on !BR2_ZLYME_DEVICE_MY355 || !BR2_LINUX_KERNEL
```

## package/drivers/rocknix-joypad/Config.in
```kconfig
config BR2_PACKAGE_ROCKNIX_JOYPAD
	bool "rocknix-joypad"
	depends on BR2_ZLYME_DEVICE_MY355
	depends on BR2_LINUX_KERNEL
	help
	  rocknix-singleadc-joypad. The DTS node is already in
	  board/my355/linux/dts (compatible "rocknix-singleadc-joypad",
	  rocknix,use-miyoo-serial-joypad). Without this module the
	  buttons and stick do not exist as an input device.

	  https://github.com/ROCKNIX/rocknix-joypad

comment "rocknix-joypad needs the Miyoo Flip target and a kernel"
	depends on !BR2_ZLYME_DEVICE_MY355 || !BR2_LINUX_KERNEL
```

## package/drivers/rtl8723fu-firmware/Config.in
```kconfig
config BR2_PACKAGE_RTL8723FU_FIRMWARE
	bool "rtl8723fu-firmware"
	help
	  Bluetooth firmware for the RTL8733BU combo chip, 50 KB.

	  Not in linux-firmware and never will be -- upstream has 8723a/b/bs/cs/d
	  and no "fu" variant -- so without this there is no hci0 no matter which
	  firmware package is installed. The kernel loads it directly from
	  /lib/firmware/rtl_bt/, so no userspace helper is needed.
```

## package/drivers/rtl8733bu-power/Config.in
```kconfig
config BR2_PACKAGE_RTL8733BU_POWER
	bool "rtl8733bu-power"
	depends on BR2_ZLYME_DEVICE_MY355
	depends on BR2_LINUX_KERNEL
	help
	  Power and rfkill control for the RTL8733BU combo chip.

	  Owns the chip's enable GPIO and registers one WLAN and one Bluetooth
	  rfkill against it, cutting power only when both are blocked. Needs the
	  "rockchip,rtl8733bu-power" node in the device tree, which
	  board/my355/linux/dts already carries.

comment "rtl8733bu-power needs the Miyoo Flip target and a kernel"
	depends on !BR2_ZLYME_DEVICE_MY355 || !BR2_LINUX_KERNEL
```

## package/drivers/rtl8733bu/Config.in
```kconfig
config BR2_PACKAGE_RTL8733BU
	bool "rtl8733bu"
	depends on BR2_LINUX_KERNEL
	help
	  Realtek RTL8733BU WiFi driver, out of tree.

	  This is the WiFi half of the Miyoo Flip's USB WiFi/Bluetooth combo
	  chip. Both halves share one firmware load, so this wants
	  rtl8733bu-power alongside it and btusb blacklisted; see
	  package/drivers/rtl8733bu-power and board/my355/fsoverlay/etc/modprobe.d.

	  https://github.com/Charliechen114514/rtl8733bu-linux-driver

comment "rtl8733bu needs a kernel to build against"
	depends on !BR2_LINUX_KERNEL
```

## package/emulators/Config.in
```kconfig
# Libretro cores and standalones.

source "$BR2_EXTERNAL_ZLYME_PATH/package/emulators/retroarch/Config.in"
source "$BR2_EXTERNAL_ZLYME_PATH/package/emulators/libretro-gambatte/Config.in"
source "$BR2_EXTERNAL_ZLYME_PATH/package/emulators/libretro-gpsp/Config.in"
source "$BR2_EXTERNAL_ZLYME_PATH/package/emulators/libretro-beetle-supafaust/Config.in"
source "$BR2_EXTERNAL_ZLYME_PATH/package/emulators/libretro-genesisplusgx/Config.in"
source "$BR2_EXTERNAL_ZLYME_PATH/package/emulators/libretro-picodrive/Config.in"
source "$BR2_EXTERNAL_ZLYME_PATH/package/emulators/libretro-nestopia/Config.in"
source "$BR2_EXTERNAL_ZLYME_PATH/package/emulators/libretro-pcsx/Config.in"
source "$BR2_EXTERNAL_ZLYME_PATH/package/emulators/libretro-stella/Config.in"
source "$BR2_EXTERNAL_ZLYME_PATH/package/emulators/libretro-prosystem/Config.in"
source "$BR2_EXTERNAL_ZLYME_PATH/package/emulators/libretro-a5200/Config.in"
source "$BR2_EXTERNAL_ZLYME_PATH/package/emulators/libretro-atari800/Config.in"
source "$BR2_EXTERNAL_ZLYME_PATH/package/emulators/libretro-handy/Config.in"
source "$BR2_EXTERNAL_ZLYME_PATH/package/emulators/libretro-hatari/Config.in"
source "$BR2_EXTERNAL_ZLYME_PATH/package/emulators/libretro-beetle-ngp/Config.in"
source "$BR2_EXTERNAL_ZLYME_PATH/package/emulators/libretro-beetle-wswan/Config.in"
source "$BR2_EXTERNAL_ZLYME_PATH/package/emulators/libretro-beetle-vb/Config.in"
source "$BR2_EXTERNAL_ZLYME_PATH/package/emulators/libretro-beetle-pce-fast/Config.in"
source "$BR2_EXTERNAL_ZLYME_PATH/package/emulators/libretro-beetle-supergrafx/Config.in"
source "$BR2_EXTERNAL_ZLYME_PATH/package/emulators/libretro-pokemini/Config.in"
source "$BR2_EXTERNAL_ZLYME_PATH/package/emulators/libretro-o2em/Config.in"
source "$BR2_EXTERNAL_ZLYME_PATH/package/emulators/libretro-vecx/Config.in"
source "$BR2_EXTERNAL_ZLYME_PATH/package/emulators/libretro-bluemsx/Config.in"
source "$BR2_EXTERNAL_ZLYME_PATH/package/emulators/libretro-gearcoleco/Config.in"
source "$BR2_EXTERNAL_ZLYME_PATH/package/emulators/libretro-freeintv/Config.in"
source "$BR2_EXTERNAL_ZLYME_PATH/package/emulators/libretro-fbneo/Config.in"
source "$BR2_EXTERNAL_ZLYME_PATH/package/emulators/libretro-mame2003-plus/Config.in"
source "$BR2_EXTERNAL_ZLYME_PATH/package/emulators/libretro-neocd/Config.in"
source "$BR2_EXTERNAL_ZLYME_PATH/package/emulators/libretro-opera/Config.in"
source "$BR2_EXTERNAL_ZLYME_PATH/package/emulators/libretro-dosbox-pure/Config.in"
source "$BR2_EXTERNAL_ZLYME_PATH/package/emulators/libretro-tic80/Config.in"
source "$BR2_EXTERNAL_ZLYME_PATH/package/emulators/libretro-fake08/Config.in"
source "$BR2_EXTERNAL_ZLYME_PATH/package/emulators/liblcf/Config.in"
source "$BR2_EXTERNAL_ZLYME_PATH/package/emulators/libretro-easyrpg/Config.in"
source "$BR2_EXTERNAL_ZLYME_PATH/package/emulators/libretro-mkxp-z/Config.in"
source "$BR2_EXTERNAL_ZLYME_PATH/package/emulators/libretro-mupen64plus-next/Config.in"
source "$BR2_EXTERNAL_ZLYME_PATH/package/emulators/libretro-yabasanshiro/Config.in"
source "$BR2_EXTERNAL_ZLYME_PATH/package/emulators/ppsspp/Config.in"
source "$BR2_EXTERNAL_ZLYME_PATH/package/emulators/flycast/Config.in"
source "$BR2_EXTERNAL_ZLYME_PATH/package/emulators/scummvm/Config.in"
source "$BR2_EXTERNAL_ZLYME_PATH/package/emulators/hypseus-singe/Config.in"
source "$BR2_EXTERNAL_ZLYME_PATH/package/emulators/amiberry/Config.in"
source "$BR2_EXTERNAL_ZLYME_PATH/package/emulators/openbor/Config.in"
source "$BR2_EXTERNAL_ZLYME_PATH/package/emulators/moonlight/Config.in"
source "$BR2_EXTERNAL_ZLYME_PATH/package/emulators/gzdoom/Config.in"
source "$BR2_EXTERNAL_ZLYME_PATH/package/emulators/wine-amd64/Config.in"
source "$BR2_EXTERNAL_ZLYME_PATH/package/emulators/pico8/Config.in"
source "$BR2_EXTERNAL_ZLYME_PATH/package/emulators/drastic/Config.in"
source "$BR2_EXTERNAL_ZLYME_PATH/package/emulators/aethersx2/Config.in"
source "$BR2_EXTERNAL_ZLYME_PATH/package/emulators/dolphin-emu/Config.in"
```

## package/emulators/aethersx2/Config.in
```kconfig
config BR2_PACKAGE_AETHERSX2
	bool "aethersx2"
	depends on BR2_aarch64
	depends on BR2_PACKAGE_HAS_LIBGLES
	select BR2_PACKAGE_LIBFUSE
	select BR2_PACKAGE_LIBGPG_ERROR
	select BR2_PACKAGE_XZ
	select BR2_PACKAGE_LIBPCAP
	select BR2_PACKAGE_QT6
	select BR2_PACKAGE_QT6BASE
	select BR2_PACKAGE_QT6BASE_GUI
	select BR2_PACKAGE_QT6BASE_WIDGETS
	select BR2_PACKAGE_QT6BASE_EGLFS
	select BR2_PACKAGE_QT6BASE_OPENGL
	select BR2_PACKAGE_QT6BASE_OPENGL_ES2
	help
	  AetherSX2 (ARM PS2). Prebuilt tarball from ROCKNIX/packages,
	  Qt6 EGLFS. BIOS in /storage/Bios/PS2.

comment "aethersx2 needs aarch64, GLES, and Qt6 EGLFS"
	depends on !BR2_aarch64 || !BR2_PACKAGE_HAS_LIBGLES
```

## package/emulators/amiberry/Config.in
```kconfig
config BR2_PACKAGE_AMIBERRY
	bool "amiberry"
	depends on BR2_aarch64
	depends on BR2_INSTALL_LIBSTDCPP
	select BR2_PACKAGE_SDL2
	select BR2_PACKAGE_SDL2_IMAGE
	select BR2_PACKAGE_SDL2_TTF
	select BR2_PACKAGE_MPG123
	select BR2_PACKAGE_LIBXML2
	select BR2_PACKAGE_LIBMPEG2
	select BR2_PACKAGE_FLAC
	select BR2_PACKAGE_LIBPNG
	select BR2_PACKAGE_LIBSERIALPORT
	select BR2_PACKAGE_ZLIB
	select BR2_PACKAGE_ENET
	select BR2_PACKAGE_LIBPCAP
	select BR2_PACKAGE_LIBPORTMIDI
	help
	  Amiga emulator for ARM boards. SDL2, no OpenGL.

	  https://github.com/BlitterStudio/amiberry

comment "amiberry needs aarch64 and C++"
	depends on !BR2_aarch64 || !BR2_INSTALL_LIBSTDCPP
```

## package/emulators/dolphin-emu/Config.in
```kconfig
config BR2_PACKAGE_DOLPHIN_EMU
	bool "dolphin-emu"
	depends on BR2_aarch64
	depends on BR2_PACKAGE_HAS_LIBGLES
	depends on BR2_INSTALL_LIBSTDCPP
	select BR2_PACKAGE_LIBEVDEV
	select BR2_PACKAGE_FFMPEG
	select BR2_PACKAGE_ZLIB
	select BR2_PACKAGE_XZ
	select BR2_PACKAGE_LIBPNG
	select BR2_PACKAGE_LZO
	select BR2_PACKAGE_LIBUSB
	select BR2_PACKAGE_LIBCURL
	select BR2_PACKAGE_BLUEZ5_UTILS
	select BR2_PACKAGE_HIDAPI
	select BR2_PACKAGE_LIBDRM
	select BR2_PACKAGE_SDL2
	help
	  GameCube / Wii. Knulli nogui + EGL DRM, no Qt/Wayland/X11.
	  IPL lives in /storage/Bios/GC.

comment "dolphin-emu needs aarch64, GLES, and C++"
	depends on !BR2_aarch64 || !BR2_PACKAGE_HAS_LIBGLES || !BR2_INSTALL_LIBSTDCPP
```

## package/emulators/drastic/Config.in
```kconfig
config BR2_PACKAGE_DRASTIC
	bool "drastic"
	depends on BR2_aarch64
	select BR2_PACKAGE_SDL2
	help
	  DraStic Nintendo DS. Proprietary binary from ROCKNIX
	  packages plus a GLES touch hook.

	  https://www.drastic-ds.com/

comment "drastic needs aarch64"
	depends on !BR2_aarch64
```

## package/emulators/dsperate/Config.in
```kconfig
config BR2_PACKAGE_DSPERATE
	bool "dsperate"
	depends on BR2_aarch64
	select BR2_PACKAGE_SDL2
	select BR2_PACKAGE_ALSA_LIB
	help
	  DSperate Nintendo DS emulator, v3.4.0. Open source,
	  GPL-3.0-or-later. The only NDS emulator in the product image.

	  https://github.com/beebono/DSperate

comment "dsperate needs aarch64"
	depends on !BR2_aarch64
```

## package/emulators/flycast/Config.in
```kconfig
config BR2_PACKAGE_FLYCAST
	bool "flycast"
	depends on BR2_PACKAGE_HAS_LIBGLES
	depends on BR2_INSTALL_LIBSTDCPP
	select BR2_PACKAGE_LIBZIP
	select BR2_PACKAGE_LIBPNG
	select BR2_PACKAGE_SDL2
	select BR2_PACKAGE_LIBCURL
	select BR2_PACKAGE_ZLIB
	help
	  Flycast standalone (Dreamcast) v2.5, GLES.

comment "flycast needs GLES and C++"
	depends on !BR2_PACKAGE_HAS_LIBGLES || !BR2_INSTALL_LIBSTDCPP
```

## package/emulators/gzdoom/Config.in
```kconfig
config BR2_PACKAGE_GZDOOM
	bool "gzdoom"
	depends on BR2_INSTALL_LIBSTDCPP
	depends on BR2_PACKAGE_HAS_LIBGLES
	select BR2_PACKAGE_HOST_GZDOOM
	select BR2_PACKAGE_SDL2
	select BR2_PACKAGE_OPENAL
	select BR2_PACKAGE_ZMUSIC
	select BR2_PACKAGE_LIBVPX
	select BR2_PACKAGE_WEBP
	select BR2_PACKAGE_WEBP_DEMUX
	select BR2_PACKAGE_WEBP_MUX
	select BR2_PACKAGE_JPEG
	select BR2_PACKAGE_BZIP2
	select BR2_PACKAGE_ZLIB
	help
	  GZDoom GLES2 source port. No Vulkan/X11/Wayland.

	  https://zdoom.org

config BR2_PACKAGE_HOST_GZDOOM
	bool

comment "gzdoom needs GLES and C++"
	depends on !BR2_PACKAGE_HAS_LIBGLES || !BR2_INSTALL_LIBSTDCPP
```

## package/emulators/hypseus-singe/Config.in
```kconfig
config BR2_PACKAGE_HYPSEUS_SINGE
	bool "hypseus-singe"
	depends on BR2_INSTALL_LIBSTDCPP
	select BR2_PACKAGE_SDL2
	select BR2_PACKAGE_SDL2_IMAGE
	select BR2_PACKAGE_SDL2_TTF
	select BR2_PACKAGE_SDL2_MIXER
	select BR2_PACKAGE_ZLIB
	select BR2_PACKAGE_LIBOGG
	select BR2_PACKAGE_LIBVORBIS
	select BR2_PACKAGE_LIBMPEG2
	select BR2_PACKAGE_LIBZIP
	help
	  Laserdisc arcade (Dragon's Lair, Space Ace, Singe).
	  SDL2 + GLES. Replaces libretro-daphne.

	  https://github.com/DirtBagXon/hypseus-singe

comment "hypseus-singe needs C++"
	depends on !BR2_INSTALL_LIBSTDCPP
```

## package/emulators/liblcf/Config.in
```kconfig
config BR2_PACKAGE_LIBLCF
	bool "liblcf"
	depends on BR2_INSTALL_LIBSTDCPP
	select BR2_PACKAGE_EXPAT
	select BR2_PACKAGE_ICU
	select BR2_PACKAGE_INIH
	help
	  Library to handle RPG Maker 2000 and 2003 game data.
	  EasyRPG Project. https://easyrpg.org/

comment "liblcf needs a toolchain w/ C++"
	depends on !BR2_INSTALL_LIBSTDCPP
```
