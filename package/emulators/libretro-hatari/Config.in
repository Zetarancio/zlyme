## package/emulators/libretro-hatari/Config.in
```kconfig
config BR2_PACKAGE_LIBRETRO_HATARI
	bool "libretro-hatari"
	depends on BR2_PACKAGE_RETROARCH
	depends on BR2_INSTALL_LIBSTDCPP
	select BR2_PACKAGE_ZLIB
	help
	  Libretro core

comment "libretro-hatari needs a toolchain w/ C++"
	depends on !BR2_INSTALL_LIBSTDCPP
```

## package/emulators/libretro-lowresnx/Config.in
```kconfig
config BR2_PACKAGE_LIBRETRO_LOWRESNX
	bool "libretro-lowresnx"
	depends on BR2_PACKAGE_RETROARCH
	depends on BR2_INSTALL_LIBSTDCPP
	help
	  Libretro core

comment "libretro-lowresnx needs a toolchain w/ C++"
	depends on !BR2_INSTALL_LIBSTDCPP
```

## package/emulators/libretro-lutro/Config.in
```kconfig
config BR2_PACKAGE_LIBRETRO_LUTRO
	bool "libretro-lutro"
	depends on BR2_PACKAGE_RETROARCH
	depends on BR2_INSTALL_LIBSTDCPP
	help
	  Libretro core

comment "libretro-lutro needs a toolchain w/ C++"
	depends on !BR2_INSTALL_LIBSTDCPP
```

## package/emulators/libretro-mame2003-plus/Config.in
```kconfig
config BR2_PACKAGE_LIBRETRO_MAME2003_PLUS
	bool "libretro-mame2003-plus"
	depends on BR2_PACKAGE_RETROARCH
	depends on BR2_INSTALL_LIBSTDCPP
	help
	  Libretro core

comment "libretro-mame2003-plus needs a toolchain w/ C++"
	depends on !BR2_INSTALL_LIBSTDCPP
```

## package/emulators/libretro-melonds-ds/Config.in
```kconfig
config BR2_PACKAGE_LIBRETRO_MELONDS_DS
	bool "libretro-melonds-ds"
	depends on BR2_PACKAGE_RETROARCH
	depends on BR2_INSTALL_LIBSTDCPP
	select BR2_PACKAGE_LIBPCAP
	help
	  Libretro core

comment "libretro-melonds-ds needs a toolchain w/ C++"
	depends on !BR2_INSTALL_LIBSTDCPP
```

## package/emulators/libretro-melonds/Config.in
```kconfig
config BR2_PACKAGE_LIBRETRO_MELONDS
	bool "libretro-melonds"
	depends on BR2_PACKAGE_RETROARCH
	depends on BR2_INSTALL_LIBSTDCPP
	select BR2_PACKAGE_LIBPCAP
	help
	  Libretro core

comment "libretro-melonds needs a toolchain w/ C++"
	depends on !BR2_INSTALL_LIBSTDCPP
```

## package/emulators/libretro-mesens/Config.in
```kconfig
config BR2_PACKAGE_LIBRETRO_MESENS
	bool "libretro-mesens"
	depends on BR2_PACKAGE_RETROARCH
	depends on BR2_INSTALL_LIBSTDCPP
	help
	  Libretro core

comment "libretro-mesens needs a toolchain w/ C++"
	depends on !BR2_INSTALL_LIBSTDCPP
```

## package/emulators/libretro-minivmac/Config.in
```kconfig
config BR2_PACKAGE_LIBRETRO_MINIVMAC
	bool "libretro-minivmac"
	depends on BR2_PACKAGE_RETROARCH
	depends on BR2_INSTALL_LIBSTDCPP
	help
	  Libretro core

comment "libretro-minivmac needs a toolchain w/ C++"
	depends on !BR2_INSTALL_LIBSTDCPP
```

## package/emulators/libretro-mkxp-z/Config.in
```kconfig
config BR2_PACKAGE_LIBRETRO_MKXP_Z
	bool "libretro-mkxp-z"
	depends on BR2_PACKAGE_RETROARCH
	depends on BR2_INSTALL_LIBSTDCPP
	select BR2_PACKAGE_OPENSSL
	select BR2_PACKAGE_ZLIB
	select BR2_PACKAGE_LIBPNG
	help
	  mkxp-z libretro core (RPG Maker XP / VX / VX Ace).
	  white-axe/mkxp-z branch libretro. Host stage1 embeds Ruby 3.3
	  via WASI SDK 30 (no target ruby).

	  https://github.com/white-axe/mkxp-z

comment "libretro-mkxp-z needs a toolchain w/ C++"
	depends on !BR2_INSTALL_LIBSTDCPP
```

## package/emulators/libretro-mupen64plus-next/Config.in
```kconfig
config BR2_PACKAGE_LIBRETRO_MUPEN64PLUS_NEXT
	bool "libretro-mupen64plus-next"
	depends on BR2_PACKAGE_RETROARCH
	depends on BR2_INSTALL_LIBSTDCPP
	help
	  Libretro core

comment "libretro-mupen64plus-next needs a toolchain w/ C++"
	depends on !BR2_INSTALL_LIBSTDCPP
```

## package/emulators/libretro-neocd/Config.in
```kconfig
config BR2_PACKAGE_LIBRETRO_NEOCD
	bool "libretro-neocd"
	depends on BR2_PACKAGE_RETROARCH
	depends on BR2_INSTALL_LIBSTDCPP
	help
	  Libretro core

comment "libretro-neocd needs a toolchain w/ C++"
	depends on !BR2_INSTALL_LIBSTDCPP
```

## package/emulators/libretro-opera/Config.in
```kconfig
config BR2_PACKAGE_LIBRETRO_OPERA
	bool "libretro-opera"
	depends on BR2_PACKAGE_RETROARCH
	depends on BR2_INSTALL_LIBSTDCPP
	help
	  Libretro core

comment "libretro-opera needs a toolchain w/ C++"
	depends on !BR2_INSTALL_LIBSTDCPP
```

## package/emulators/libretro-parallel-n64/Config.in
```kconfig
config BR2_PACKAGE_LIBRETRO_PARALLEL_N64
	bool "libretro-parallel-n64"
	depends on BR2_PACKAGE_RETROARCH
	depends on BR2_INSTALL_LIBSTDCPP
	help
	  Libretro core

comment "libretro-parallel-n64 needs a toolchain w/ C++"
	depends on !BR2_INSTALL_LIBSTDCPP
```

## package/emulators/libretro-pc88/Config.in
```kconfig
config BR2_PACKAGE_LIBRETRO_PC88
	bool "libretro-pc88"
	depends on BR2_PACKAGE_RETROARCH
	depends on BR2_INSTALL_LIBSTDCPP
	help
	  Libretro core

comment "libretro-pc88 needs a toolchain w/ C++"
	depends on !BR2_INSTALL_LIBSTDCPP
```

## package/emulators/libretro-pc98/Config.in
```kconfig
config BR2_PACKAGE_LIBRETRO_PC98
	bool "libretro-pc98"
	depends on BR2_PACKAGE_RETROARCH
	depends on BR2_INSTALL_LIBSTDCPP
	help
	  Libretro core

comment "libretro-pc98 needs a toolchain w/ C++"
	depends on !BR2_INSTALL_LIBSTDCPP
```

## package/emulators/libretro-pcsx/Config.in
```kconfig
config BR2_PACKAGE_LIBRETRO_PCSX
	bool "libretro-pcsx"
	depends on BR2_PACKAGE_RETROARCH
	depends on BR2_INSTALL_LIBSTDCPP
	help
	  Libretro core

comment "libretro-pcsx needs a toolchain w/ C++"
	depends on !BR2_INSTALL_LIBSTDCPP
```

## package/emulators/libretro-picodrive/Config.in
```kconfig
config BR2_PACKAGE_LIBRETRO_PICODRIVE
	bool "libretro-picodrive"
	depends on BR2_PACKAGE_RETROARCH
	depends on BR2_INSTALL_LIBSTDCPP
	select BR2_PACKAGE_LIBPNG
	help
	  Libretro core

comment "libretro-picodrive needs a toolchain w/ C++"
	depends on !BR2_INSTALL_LIBSTDCPP
```

## package/emulators/libretro-pokemini/Config.in
```kconfig
config BR2_PACKAGE_LIBRETRO_POKEMINI
	bool "libretro-pokemini"
	depends on BR2_PACKAGE_RETROARCH
	depends on BR2_INSTALL_LIBSTDCPP
	help
	  Libretro core

comment "libretro-pokemini needs a toolchain w/ C++"
	depends on !BR2_INSTALL_LIBSTDCPP
```

## package/emulators/libretro-prboom/Config.in
```kconfig
config BR2_PACKAGE_LIBRETRO_PRBOOM
	bool "libretro-prboom"
	depends on BR2_PACKAGE_RETROARCH
	depends on BR2_INSTALL_LIBSTDCPP
	help
	  Libretro core

comment "libretro-prboom needs a toolchain w/ C++"
	depends on !BR2_INSTALL_LIBSTDCPP
```

## package/emulators/libretro-puae2021/Config.in
```kconfig
config BR2_PACKAGE_LIBRETRO_PUAE2021
	bool "libretro-puae2021"
	depends on BR2_PACKAGE_RETROARCH
	depends on BR2_INSTALL_LIBSTDCPP
	help
	  Libretro core

comment "libretro-puae2021 needs a toolchain w/ C++"
	depends on !BR2_INSTALL_LIBSTDCPP
```

## package/emulators/libretro-px68k/Config.in
```kconfig
config BR2_PACKAGE_LIBRETRO_PX68K
	bool "libretro-px68k"
	depends on BR2_PACKAGE_RETROARCH
	depends on BR2_INSTALL_LIBSTDCPP
	help
	  Libretro core

comment "libretro-px68k needs a toolchain w/ C++"
	depends on !BR2_INSTALL_LIBSTDCPP
```

## package/emulators/libretro-reminiscence/Config.in
```kconfig
config BR2_PACKAGE_LIBRETRO_REMINISCENCE
	bool "libretro-reminiscence"
	depends on BR2_PACKAGE_RETROARCH
	depends on BR2_INSTALL_LIBSTDCPP
	help
	  Libretro core

comment "libretro-reminiscence needs a toolchain w/ C++"
	depends on !BR2_INSTALL_LIBSTDCPP
```

## package/emulators/libretro-same-cdi/Config.in
```kconfig
config BR2_PACKAGE_LIBRETRO_SAME_CDI
	bool "libretro-same-cdi"
	depends on BR2_PACKAGE_RETROARCH
	depends on BR2_INSTALL_LIBSTDCPP
	help
	  Libretro core

comment "libretro-same-cdi needs a toolchain w/ C++"
	depends on !BR2_INSTALL_LIBSTDCPP
```

## package/emulators/libretro-sameduck/Config.in
```kconfig
config BR2_PACKAGE_LIBRETRO_SAMEDUCK
	bool "libretro-sameduck"
	depends on BR2_PACKAGE_RETROARCH
	depends on BR2_INSTALL_LIBSTDCPP
	help
	  Libretro core

comment "libretro-sameduck needs a toolchain w/ C++"
	depends on !BR2_INSTALL_LIBSTDCPP
```

## package/emulators/libretro-smsplus-gx/Config.in
```kconfig
config BR2_PACKAGE_LIBRETRO_SMSPLUS_GX
	bool "libretro-smsplus-gx"
	depends on BR2_PACKAGE_RETROARCH
	depends on BR2_INSTALL_LIBSTDCPP
	help
	  Libretro core

comment "libretro-smsplus-gx needs a toolchain w/ C++"
	depends on !BR2_INSTALL_LIBSTDCPP
```
