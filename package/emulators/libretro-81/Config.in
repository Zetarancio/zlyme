## package/emulators/libretro-81/Config.in
```kconfig
config BR2_PACKAGE_LIBRETRO_81
	bool "libretro-81"
	depends on BR2_PACKAGE_RETROARCH
	depends on BR2_INSTALL_LIBSTDCPP
	help
	  Libretro core

comment "libretro-81 needs a toolchain w/ C++"
	depends on !BR2_INSTALL_LIBSTDCPP
```

## package/emulators/libretro-a5200/Config.in
```kconfig
config BR2_PACKAGE_LIBRETRO_A5200
	bool "libretro-a5200"
	depends on BR2_PACKAGE_RETROARCH
	depends on BR2_INSTALL_LIBSTDCPP
	help
	  Libretro core

comment "libretro-a5200 needs a toolchain w/ C++"
	depends on !BR2_INSTALL_LIBSTDCPP
```

## package/emulators/libretro-arduous/Config.in
```kconfig
config BR2_PACKAGE_LIBRETRO_ARDUOUS
	bool "libretro-arduous"
	depends on BR2_PACKAGE_RETROARCH
	depends on BR2_INSTALL_LIBSTDCPP
	help
	  Libretro core

comment "libretro-arduous needs a toolchain w/ C++"
	depends on !BR2_INSTALL_LIBSTDCPP
```

## package/emulators/libretro-atari800/Config.in
```kconfig
config BR2_PACKAGE_LIBRETRO_ATARI800
	bool "libretro-atari800"
	depends on BR2_PACKAGE_RETROARCH
	depends on BR2_INSTALL_LIBSTDCPP
	help
	  Libretro core

comment "libretro-atari800 needs a toolchain w/ C++"
	depends on !BR2_INSTALL_LIBSTDCPP
```

## package/emulators/libretro-beetle-lynx/Config.in
```kconfig
config BR2_PACKAGE_LIBRETRO_BEETLE_LYNX
	bool "libretro-beetle-lynx"
	depends on BR2_PACKAGE_RETROARCH
	depends on BR2_INSTALL_LIBSTDCPP
	help
	  Libretro core

comment "libretro-beetle-lynx needs a toolchain w/ C++"
	depends on !BR2_INSTALL_LIBSTDCPP
```

## package/emulators/libretro-beetle-ngp/Config.in
```kconfig
config BR2_PACKAGE_LIBRETRO_BEETLE_NGP
	bool "libretro-beetle-ngp"
	depends on BR2_PACKAGE_RETROARCH
	depends on BR2_INSTALL_LIBSTDCPP
	help
	  Libretro core

comment "libretro-beetle-ngp needs a toolchain w/ C++"
	depends on !BR2_INSTALL_LIBSTDCPP
```

## package/emulators/libretro-beetle-pce-fast/Config.in
```kconfig
config BR2_PACKAGE_LIBRETRO_BEETLE_PCE_FAST
	bool "libretro-beetle-pce-fast"
	depends on BR2_PACKAGE_RETROARCH
	depends on BR2_INSTALL_LIBSTDCPP
	help
	  Libretro core

comment "libretro-beetle-pce-fast needs a toolchain w/ C++"
	depends on !BR2_INSTALL_LIBSTDCPP
```

## package/emulators/libretro-beetle-supafaust/Config.in
```kconfig
config BR2_PACKAGE_LIBRETRO_BEETLE_SUPAFAUST
	bool "libretro-beetle-supafaust"
	depends on BR2_PACKAGE_RETROARCH
	depends on BR2_INSTALL_LIBSTDCPP
	help
	  Super Nintendo (Super Famicom) emulator

comment "libretro-beetle-supafaust needs a toolchain w/ C++"
	depends on !BR2_INSTALL_LIBSTDCPP
```

## package/emulators/libretro-beetle-supergrafx/Config.in
```kconfig
config BR2_PACKAGE_LIBRETRO_BEETLE_SUPERGRAFX
	bool "libretro-beetle-supergrafx"
	depends on BR2_PACKAGE_RETROARCH
	depends on BR2_INSTALL_LIBSTDCPP
	help
	  Libretro core

comment "libretro-beetle-supergrafx needs a toolchain w/ C++"
	depends on !BR2_INSTALL_LIBSTDCPP
```

## package/emulators/libretro-beetle-vb/Config.in
```kconfig
config BR2_PACKAGE_LIBRETRO_BEETLE_VB
	bool "libretro-beetle-vb"
	depends on BR2_PACKAGE_RETROARCH
	depends on BR2_INSTALL_LIBSTDCPP
	help
	  Libretro core

comment "libretro-beetle-vb needs a toolchain w/ C++"
	depends on !BR2_INSTALL_LIBSTDCPP
```

## package/emulators/libretro-bluemsx/Config.in
```kconfig
config BR2_PACKAGE_LIBRETRO_BLUEMSX
	bool "libretro-bluemsx"
	depends on BR2_PACKAGE_RETROARCH
	depends on BR2_INSTALL_LIBSTDCPP
	help
	  Libretro core

comment "libretro-bluemsx needs a toolchain w/ C++"
	depends on !BR2_INSTALL_LIBSTDCPP
```

## package/emulators/libretro-cap32/Config.in
```kconfig
config BR2_PACKAGE_LIBRETRO_CAP32
	bool "libretro-cap32"
	depends on BR2_PACKAGE_RETROARCH
	depends on BR2_INSTALL_LIBSTDCPP
	help
	  Libretro core

comment "libretro-cap32 needs a toolchain w/ C++"
	depends on !BR2_INSTALL_LIBSTDCPP
```

## package/emulators/libretro-easyrpg/Config.in
```kconfig
config BR2_PACKAGE_LIBRETRO_EASYRPG
	bool "libretro-easyrpg"
	depends on BR2_PACKAGE_RETROARCH
	depends on BR2_INSTALL_LIBSTDCPP
	select BR2_PACKAGE_SDL2
	select BR2_PACKAGE_SDL2_MIXER
	select BR2_PACKAGE_LIBPNG
	select BR2_PACKAGE_ZLIB
	select BR2_PACKAGE_FMT
	select BR2_PACKAGE_FREETYPE
	select BR2_PACKAGE_MPG123
	select BR2_PACKAGE_LIBVORBIS
	select BR2_PACKAGE_OPUSFILE
	select BR2_PACKAGE_PIXMAN
	select BR2_PACKAGE_SPEEXDSP
	select BR2_PACKAGE_LIBXMP
	select BR2_PACKAGE_WILDMIDI
	select BR2_PACKAGE_LIBLCF
	select BR2_PACKAGE_FLUIDSYNTH
	help
	  EasyRPG Player libretro core (RPG Maker 2000/2003).

	  https://easyrpg.org/

comment "libretro-easyrpg needs a toolchain w/ C++"
	depends on !BR2_INSTALL_LIBSTDCPP
```

## package/emulators/libretro-emuscv/Config.in
```kconfig
config BR2_PACKAGE_LIBRETRO_EMUSCV
	bool "libretro-emuscv"
	depends on BR2_PACKAGE_RETROARCH
	depends on BR2_INSTALL_LIBSTDCPP
	select BR2_PACKAGE_SDL2
	help
	  Libretro core

comment "libretro-emuscv needs a toolchain w/ C++"
	depends on !BR2_INSTALL_LIBSTDCPP
```

## package/emulators/libretro-fake08/Config.in
```kconfig
config BR2_PACKAGE_LIBRETRO_FAKE08
	bool "libretro-fake08"
	depends on BR2_PACKAGE_RETROARCH
	depends on BR2_INSTALL_LIBSTDCPP
	help
	  Libretro core

comment "libretro-fake08 needs a toolchain w/ C++"
	depends on !BR2_INSTALL_LIBSTDCPP
```

## package/emulators/libretro-fbalpha/Config.in
```kconfig
config BR2_PACKAGE_LIBRETRO_FBALPHA
	bool "libretro-fbalpha"
	depends on BR2_PACKAGE_RETROARCH
	depends on BR2_INSTALL_LIBSTDCPP
	help
	  Libretro core

comment "libretro-fbalpha needs a toolchain w/ C++"
	depends on !BR2_INSTALL_LIBSTDCPP
```

## package/emulators/libretro-fbneo/Config.in
```kconfig
config BR2_PACKAGE_LIBRETRO_FBNEO
	bool "libretro-fbneo"
	depends on BR2_PACKAGE_RETROARCH
	depends on BR2_INSTALL_LIBSTDCPP
	help
	  Libretro core

comment "libretro-fbneo needs a toolchain w/ C++"
	depends on !BR2_INSTALL_LIBSTDCPP
```

## package/emulators/libretro-fceumm/Config.in
```kconfig
config BR2_PACKAGE_LIBRETRO_FCEUMM
	bool "libretro-fceumm"
	depends on BR2_PACKAGE_RETROARCH
	depends on BR2_INSTALL_LIBSTDCPP
	help
	  NES.

comment "libretro-fceumm needs a toolchain w/ C++"
	depends on !BR2_INSTALL_LIBSTDCPP
```

## package/emulators/libretro-flycast/Config.in
```kconfig
config BR2_PACKAGE_LIBRETRO_FLYCAST
	bool "libretro-flycast"
	depends on BR2_PACKAGE_RETROARCH
	depends on BR2_INSTALL_LIBSTDCPP
	help
	  Libretro core

comment "libretro-flycast needs a toolchain w/ C++"
	depends on !BR2_INSTALL_LIBSTDCPP
```

## package/emulators/libretro-freechaf/Config.in
```kconfig
config BR2_PACKAGE_LIBRETRO_FREECHAF
	bool "libretro-freechaf"
	depends on BR2_PACKAGE_RETROARCH
	depends on BR2_INSTALL_LIBSTDCPP
	help
	  Libretro core

comment "libretro-freechaf needs a toolchain w/ C++"
	depends on !BR2_INSTALL_LIBSTDCPP
```

## package/emulators/libretro-freeintv/Config.in
```kconfig
config BR2_PACKAGE_LIBRETRO_FREEINTV
	bool "libretro-freeintv"
	depends on BR2_PACKAGE_RETROARCH
	depends on BR2_INSTALL_LIBSTDCPP
	help
	  Libretro core

comment "libretro-freeintv needs a toolchain w/ C++"
	depends on !BR2_INSTALL_LIBSTDCPP
```

## package/emulators/libretro-genesisplusgx-wide/Config.in
```kconfig
config BR2_PACKAGE_LIBRETRO_GENESISPLUSGX_WIDE
	bool "libretro-genesisplusgx-wide"
	depends on BR2_PACKAGE_RETROARCH
	depends on BR2_INSTALL_LIBSTDCPP
	help
	  Libretro core

comment "libretro-genesisplusgx-wide needs a toolchain w/ C++"
	depends on !BR2_INSTALL_LIBSTDCPP
```

## package/emulators/libretro-genesisplusgx/Config.in
```kconfig
config BR2_PACKAGE_LIBRETRO_GENESISPLUSGX
	bool "libretro-genesisplusgx"
	depends on BR2_PACKAGE_RETROARCH
	depends on BR2_INSTALL_LIBSTDCPP
	help
	  Mega Drive / Master System / Game Gear.
	  Non-commercial license.

comment "libretro-genesisplusgx needs a toolchain w/ C++"
	depends on !BR2_INSTALL_LIBSTDCPP
```

## package/emulators/libretro-gpsp/Config.in
```kconfig
config BR2_PACKAGE_LIBRETRO_GPSP
	bool "libretro-gpsp"
	depends on BR2_PACKAGE_RETROARCH
	depends on BR2_INSTALL_LIBSTDCPP
	help
	  Libretro core

comment "libretro-gpsp needs a toolchain w/ C++"
	depends on !BR2_INSTALL_LIBSTDCPP
```

## package/emulators/libretro-handy/Config.in
```kconfig
config BR2_PACKAGE_LIBRETRO_HANDY
	bool "libretro-handy"
	depends on BR2_PACKAGE_RETROARCH
	depends on BR2_INSTALL_LIBSTDCPP
	help
	  Libretro core

comment "libretro-handy needs a toolchain w/ C++"
	depends on !BR2_INSTALL_LIBSTDCPP
```
