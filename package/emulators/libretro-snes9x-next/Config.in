## package/emulators/libretro-snes9x-next/Config.in
```kconfig
config BR2_PACKAGE_LIBRETRO_SNES9X_NEXT
	bool "libretro-snes9x-next"
	depends on BR2_PACKAGE_RETROARCH
	depends on BR2_INSTALL_LIBSTDCPP
	help
	  Libretro core

comment "libretro-snes9x-next needs a toolchain w/ C++"
	depends on !BR2_INSTALL_LIBSTDCPP
```

## package/emulators/libretro-snes9x/Config.in
```kconfig
config BR2_PACKAGE_LIBRETRO_SNES9X
	bool "libretro-snes9x"
	depends on BR2_PACKAGE_RETROARCH
	depends on BR2_INSTALL_LIBSTDCPP
	select BR2_PACKAGE_ZLIB
	help
	  SNES. Non-commercial license.

comment "libretro-snes9x needs a toolchain w/ C++"
	depends on !BR2_INSTALL_LIBSTDCPP
```

## package/emulators/libretro-stella2014/Config.in
```kconfig
config BR2_PACKAGE_LIBRETRO_STELLA2014
	bool "libretro-stella2014"
	depends on BR2_PACKAGE_RETROARCH
	depends on BR2_INSTALL_LIBSTDCPP
	help
	  Libretro core

comment "libretro-stella2014 needs a toolchain w/ C++"
	depends on !BR2_INSTALL_LIBSTDCPP
```

## package/emulators/libretro-swanstation/Config.in
```kconfig
config BR2_PACKAGE_LIBRETRO_SWANSTATION
	bool "libretro-swanstation"
	depends on BR2_PACKAGE_RETROARCH
	depends on BR2_INSTALL_LIBSTDCPP
	select BR2_PACKAGE_FMT
	select BR2_PACKAGE_BOOST
	select BR2_PACKAGE_FFMPEG
	help
	  Libretro core

comment "libretro-swanstation needs a toolchain w/ C++"
	depends on !BR2_INSTALL_LIBSTDCPP
```

## package/emulators/libretro-tgbdual/Config.in
```kconfig
config BR2_PACKAGE_LIBRETRO_TGBDUAL
	bool "libretro-tgbdual"
	depends on BR2_PACKAGE_RETROARCH
	depends on BR2_INSTALL_LIBSTDCPP
	help
	  Libretro core

comment "libretro-tgbdual needs a toolchain w/ C++"
	depends on !BR2_INSTALL_LIBSTDCPP
```

## package/emulators/libretro-theodore/Config.in
```kconfig
config BR2_PACKAGE_LIBRETRO_THEODORE
	bool "libretro-theodore"
	depends on BR2_PACKAGE_RETROARCH
	depends on BR2_INSTALL_LIBSTDCPP
	help
	  Libretro core

comment "libretro-theodore needs a toolchain w/ C++"
	depends on !BR2_INSTALL_LIBSTDCPP
```

## package/emulators/libretro-tic80/Config.in
```kconfig
config BR2_PACKAGE_LIBRETRO_TIC80
	bool "libretro-tic80"
	depends on BR2_PACKAGE_RETROARCH
	depends on BR2_INSTALL_LIBSTDCPP
	select BR2_PACKAGE_JANET
	help
	  Libretro core

comment "libretro-tic80 needs a toolchain w/ C++"
	depends on !BR2_INSTALL_LIBSTDCPP
```

## package/emulators/libretro-tyrquake/Config.in
```kconfig
config BR2_PACKAGE_LIBRETRO_TYRQUAKE
	bool "libretro-tyrquake"
	depends on BR2_PACKAGE_RETROARCH
	depends on BR2_INSTALL_LIBSTDCPP
	help
	  Libretro core

comment "libretro-tyrquake needs a toolchain w/ C++"
	depends on !BR2_INSTALL_LIBSTDCPP
```

## package/emulators/libretro-uzem/Config.in
```kconfig
config BR2_PACKAGE_LIBRETRO_UZEM
	bool "libretro-uzem"
	depends on BR2_PACKAGE_RETROARCH
	depends on BR2_INSTALL_LIBSTDCPP
	help
	  Libretro core

comment "libretro-uzem needs a toolchain w/ C++"
	depends on !BR2_INSTALL_LIBSTDCPP
```

## package/emulators/libretro-vice/Config.in
```kconfig
config BR2_PACKAGE_LIBRETRO_VICE
	bool "libretro-vice"
	depends on BR2_PACKAGE_RETROARCH
	depends on BR2_INSTALL_LIBSTDCPP
	help
	  Libretro core

comment "libretro-vice needs a toolchain w/ C++"
	depends on !BR2_INSTALL_LIBSTDCPP
```

## package/emulators/libretro-virtualjaguar/Config.in
```kconfig
config BR2_PACKAGE_LIBRETRO_VIRTUALJAGUAR
	bool "libretro-virtualjaguar"
	depends on BR2_PACKAGE_RETROARCH
	depends on BR2_INSTALL_LIBSTDCPP
	help
	  Libretro core

comment "libretro-virtualjaguar needs a toolchain w/ C++"
	depends on !BR2_INSTALL_LIBSTDCPP
```

## package/emulators/libretro-wasm4/Config.in
```kconfig
config BR2_PACKAGE_LIBRETRO_WASM4
	bool "libretro-wasm4"
	depends on BR2_PACKAGE_RETROARCH
	depends on BR2_INSTALL_LIBSTDCPP
	help
	  Libretro core

comment "libretro-wasm4 needs a toolchain w/ C++"
	depends on !BR2_INSTALL_LIBSTDCPP
```

## package/emulators/libretro-watara/Config.in
```kconfig
config BR2_PACKAGE_LIBRETRO_WATARA
	bool "libretro-watara"
	depends on BR2_PACKAGE_RETROARCH
	depends on BR2_INSTALL_LIBSTDCPP
	help
	  Libretro core

comment "libretro-watara needs a toolchain w/ C++"
	depends on !BR2_INSTALL_LIBSTDCPP
```

## package/emulators/libretro-xmil/Config.in
```kconfig
config BR2_PACKAGE_LIBRETRO_XMIL
	bool "libretro-xmil"
	depends on BR2_PACKAGE_RETROARCH
	depends on BR2_INSTALL_LIBSTDCPP
	help
	  Libretro core

comment "libretro-xmil needs a toolchain w/ C++"
	depends on !BR2_INSTALL_LIBSTDCPP
```

## package/emulators/libretro-xrick/Config.in
```kconfig
config BR2_PACKAGE_LIBRETRO_XRICK
	bool "libretro-xrick"
	depends on BR2_PACKAGE_RETROARCH
	depends on BR2_INSTALL_LIBSTDCPP
	help
	  Libretro core

comment "libretro-xrick needs a toolchain w/ C++"
	depends on !BR2_INSTALL_LIBSTDCPP
```

## package/emulators/libretro-yabasanshiro/Config.in
```kconfig
config BR2_PACKAGE_LIBRETRO_YABASANSHIRO
	bool "libretro-yabasanshiro"
	depends on BR2_PACKAGE_RETROARCH
	depends on BR2_INSTALL_LIBSTDCPP
	help
	  Libretro core

comment "libretro-yabasanshiro needs a toolchain w/ C++"
	depends on !BR2_INSTALL_LIBSTDCPP
```

## package/emulators/moonlight/Config.in
```kconfig
config BR2_PACKAGE_MOONLIGHT
	bool "moonlight"
	depends on BR2_INSTALL_LIBSTDCPP
	depends on BR2_PACKAGE_HAS_LIBGLES
	depends on BR2_PACKAGE_HAS_UDEV
	select BR2_PACKAGE_OPUS
	select BR2_PACKAGE_LIBEVDEV
	select BR2_PACKAGE_DBUS
	select BR2_PACKAGE_AVAHI
	select BR2_PACKAGE_AVAHI_DAEMON
	select BR2_PACKAGE_ALSA_LIB
	select BR2_PACKAGE_LIBCURL
	select BR2_PACKAGE_ENET
	select BR2_PACKAGE_FFMPEG
	select BR2_PACKAGE_SDL2
	help
	  moonlight-embedded GameStream client. SDL2 + GLES,
	  no X11/CEC.

	  https://github.com/moonlight-stream/moonlight-embedded

comment "moonlight needs GLES, C++ and udev"
	depends on !BR2_PACKAGE_HAS_LIBGLES || !BR2_INSTALL_LIBSTDCPP || !BR2_PACKAGE_HAS_UDEV
```

## package/emulators/openbor/Config.in
```kconfig
config BR2_PACKAGE_OPENBOR
	bool "openbor"
	depends on BR2_INSTALL_LIBSTDCPP
	select BR2_PACKAGE_LIBVPX
	select BR2_PACKAGE_SDL2
	select BR2_PACKAGE_SDL2_GFX
	select BR2_PACKAGE_LIBPNG
	select BR2_PACKAGE_LIBOGG
	select BR2_PACKAGE_LIBVORBIS
	help
	  OpenBOR 4 beat-em-up engine.

	  https://github.com/DCurrent/openbor

comment "openbor needs C++"
	depends on !BR2_INSTALL_LIBSTDCPP
```

## package/emulators/pico8/Config.in
```kconfig
config BR2_PACKAGE_PICO8
	bool "pico8"
	select BR2_PACKAGE_SDL2
	help
	  PICO-8 launcher only. The fantasy-console binary is
	  proprietary; drop pico8_64 + pico8.dat in Bios/PICO
	  (MinUI). Bios/ and the Pico-8 roms folder still work.

	  https://www.lexaloffle.com/pico-8.php
```

## package/emulators/ppsspp/Config.in
```kconfig
config BR2_PACKAGE_PPSSPP
	bool "ppsspp"
	depends on BR2_PACKAGE_HAS_LIBGLES
	depends on BR2_INSTALL_LIBSTDCPP
	select BR2_PACKAGE_LIBZIP
	select BR2_PACKAGE_SDL2
	select BR2_PACKAGE_ZLIB
	select BR2_PACKAGE_LIBPNG
	help
	  PPSSPP standalone 1.19.3. GLES, no Qt.

comment "ppsspp needs GLES and C++"
	depends on !BR2_PACKAGE_HAS_LIBGLES || !BR2_INSTALL_LIBSTDCPP
```

## package/emulators/retroarch/Config.in
```kconfig
config BR2_PACKAGE_RETROARCH
	bool "retroarch"
	depends on BR2_PACKAGE_HAS_LIBGLES
	depends on BR2_PACKAGE_HAS_LIBEGL
	select BR2_PACKAGE_ALSA_LIB
	select BR2_PACKAGE_SDL2
	select BR2_PACKAGE_LIBDRM
	select BR2_PACKAGE_ZLIB
	help
	  RetroArch, built for KMSDRM + GLES + ALSA.

	  The menu is RGUI, which is
	  built in and does not need retroarch-assets.

	  http://www.libretro.com

comment "retroarch needs GLES+EGL (Mesa/Panfrost)"
	depends on !BR2_PACKAGE_HAS_LIBGLES || !BR2_PACKAGE_HAS_LIBEGL
```

## package/emulators/wine-amd64/Config.in
```kconfig
config BR2_PACKAGE_WINE_AMD64
	bool "wine-amd64"
	depends on BR2_aarch64
	select BR2_PACKAGE_BOX64
	help
	  Kron4ek Wine 11.0 amd64 build, launched through box64.
	  Not Buildroot's native wine (that symbol is BR2_PACKAGE_WINE).

	  https://github.com/Kron4ek/Wine-Builds

comment "wine-amd64 needs aarch64 (box64)"
	depends on !BR2_aarch64
```

## package/system/Config.in
```kconfig
# Recipes.

source "$BR2_EXTERNAL_ZLYME_PATH/package/system/zlyme-armhf-probe/Config.in"
source "$BR2_EXTERNAL_ZLYME_PATH/package/system/zlyme-armhf-runtime/Config.in"
source "$BR2_EXTERNAL_ZLYME_PATH/package/system/box86-armhf/Config.in"
source "$BR2_EXTERNAL_ZLYME_PATH/package/system/zlyme-box86/Config.in"
source "$BR2_EXTERNAL_ZLYME_PATH/package/system/gl4es-armhf/Config.in"
source "$BR2_EXTERNAL_ZLYME_PATH/package/system/zlyme-hdmi/Config.in"
source "$BR2_EXTERNAL_ZLYME_PATH/package/system/zlyme-artbook/Config.in"
source "$BR2_EXTERNAL_ZLYME_PATH/package/system/zlyme-jackd/Config.in"
source "$BR2_EXTERNAL_ZLYME_PATH/package/system/zlyme-keylidmon/Config.in"
source "$BR2_EXTERNAL_ZLYME_PATH/package/system/nextui/Config.in"
source "$BR2_EXTERNAL_ZLYME_PATH/package/system/minui-list/Config.in"
source "$BR2_EXTERNAL_ZLYME_PATH/package/system/minui-presenter/Config.in"
source "$BR2_EXTERNAL_ZLYME_PATH/package/system/gpudriver/Config.in"
source "$BR2_EXTERNAL_ZLYME_PATH/package/system/libmali/Config.in"
source "$BR2_EXTERNAL_ZLYME_PATH/package/system/syncthing/Config.in"
source "$BR2_EXTERNAL_ZLYME_PATH/package/system/pico8-data-extractor/Config.in"
source "$BR2_EXTERNAL_ZLYME_PATH/package/system/ruffle-handheld/Config.in"
source "$BR2_EXTERNAL_ZLYME_PATH/package/system/music-player/Config.in"
source "$BR2_EXTERNAL_ZLYME_PATH/package/system/zcrapegoat/Config.in"
source "$BR2_EXTERNAL_ZLYME_PATH/package/system/box64/Config.in"
source "$BR2_EXTERNAL_ZLYME_PATH/package/system/gl4es/Config.in"
source "$BR2_EXTERNAL_ZLYME_PATH/package/system/zlyme-graphics-probes/Config.in"
source "$BR2_EXTERNAL_ZLYME_PATH/package/system/portmaster-theora-compat/Config.in"
source "$BR2_EXTERNAL_ZLYME_PATH/package/system/portmaster/Config.in"
source "$BR2_EXTERNAL_ZLYME_PATH/package/system/zmusic/Config.in"
source "$BR2_EXTERNAL_ZLYME_PATH/package/system/libportmidi/Config.in"
source "$BR2_EXTERNAL_ZLYME_PATH/package/system/libxmp/Config.in"
source "$BR2_EXTERNAL_ZLYME_PATH/package/system/wildmidi/Config.in"
source "$BR2_EXTERNAL_ZLYME_PATH/package/system/vtree/Config.in"
source "$BR2_EXTERNAL_ZLYME_PATH/package/system/inputplumber/Config.in"
source "$BR2_EXTERNAL_ZLYME_PATH/package/system/zlyme-input/Config.in"
source "$BR2_EXTERNAL_ZLYME_PATH/package/system/zlyme-preloader/Config.in"
source "$BR2_EXTERNAL_ZLYME_PATH/package/system/zlyme-usb-transfer/Config.in"
```

## package/system/box64/Config.in
```kconfig
config BR2_PACKAGE_BOX64
	bool "box64"
	depends on BR2_aarch64
	depends on BR2_INSTALL_LIBSTDCPP
	select BR2_PACKAGE_SDL2
	help
	  box64 v0.4.4 so PortMaster x86_64 ports can run. No X11;
	  ARM dynarec only.

	  https://github.com/ptitSeb/box64

comment "box64 needs aarch64 and C++"
	depends on !BR2_aarch64 || !BR2_INSTALL_LIBSTDCPP
```

## package/system/box86-armhf/Config.in
```kconfig
config BR2_PACKAGE_BOX86_ARMHF
	bool "box86-armhf"
	depends on BR2_arm
	depends on BR2_ARM_EABIHF
	help
	  Native ARM hard-float Box86 for the separate my355 ARMHF
	  sysroot. The AArch64 product imports the verified executable
	  through zlyme-box86; this package is not selected there.

	  https://github.com/ptitSeb/box86

comment "box86-armhf needs an ARM hard-float target"
	depends on !BR2_arm || !BR2_ARM_EABIHF
```
