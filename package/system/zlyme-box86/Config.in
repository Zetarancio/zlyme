## package/system/zlyme-box86/Config.in
```kconfig
config BR2_PACKAGE_ZLYME_BOX86
	bool "zlyme-box86"
	depends on BR2_aarch64
	select BR2_PACKAGE_ZLYME_ARMHF_RUNTIME
	help
	  Import the manifest-verified ARMHF Box86 executable from the
	  separate my355 ARMHF Buildroot output. Box64 remains the
	  AArch64 x86-64 runtime and keeps BOX32 disabled.

comment "zlyme-box86 is installed into the AArch64 product"
	depends on !BR2_aarch64
```

## package/system/zlyme-graphics-probes/Config.in
```kconfig
config BR2_PACKAGE_ZLYME_GRAPHICS_PROBES
	bool "zlyme graphics validation probes"
	depends on BR2_aarch64
	select BR2_PACKAGE_SDL2
	select BR2_PACKAGE_SDL3
	select BR2_PACKAGE_GL4ES
	help
	  Small non-startup diagnostics for SDL3 KMSDRM/input and the
	  explicitly selected AArch64 GL4ES compatibility path. They
	  are launched only through temporary normal NextUI fixtures.
```

## package/system/zlyme-hdmi/Config.in
```kconfig
config BR2_PACKAGE_ZLYME_HDMI
	bool "zlyme-hdmi"
	depends on BR2_PACKAGE_LIBDRM
	help
	  Read the HDMI-A connector and print the gated 720p policy.
	  It does not modeset. Launchers apply the result.

comment "zlyme-hdmi needs libdrm"
	depends on !BR2_PACKAGE_LIBDRM
```

## package/system/zlyme-input/Config.in
```kconfig
config BR2_PACKAGE_ZLYME_INPUT
	bool "zlyme-input"
	depends on BR2_ZLYME_DEVICE_MY355
	depends on BR2_PACKAGE_INPUTPLUMBER
	select BR2_PACKAGE_DBUS
	help
	  Enables InputPlumber after the first frame, keeps external
	  controllers ahead of the built-in pad, and releases only
	  the built-in composite for Settings.

comment "zlyme-input needs the Miyoo Flip target and InputPlumber"
	depends on !BR2_ZLYME_DEVICE_MY355 || !BR2_PACKAGE_INPUTPLUMBER
```

## package/system/zlyme-jackd/Config.in
```kconfig
config BR2_PACKAGE_ZLYME_JACKD
	bool "zlyme-jackd"
	select BR2_PACKAGE_ALSA_LIB
	help
	  Sends audio to the headphones or the speaker, following the jack.

	  Both are outputs of the rk817, selected by one mixer control that
	  nothing changes on its own, so without this the output stays wherever
	  the driver left it and plugging in headphones does nothing.

	  Watches the evdev switch that simple-audio-card's hp-det publishes,
	  and writes Playback Mux (HP / SPK). The card also has a Headphones
	  Jack kcontrol; that reports insertion and does not change the mux.
```

## package/system/zlyme-keylidmon/Config.in
```kconfig
config BR2_PACKAGE_ZLYME_KEYLIDMON
	bool "zlyme-keylidmon"
	depends on BR2_ZLYME_DEVICE_MY355
	depends on BR2_PACKAGE_NEXTUI
	help
	  Volume, brightness, lid close, and power while a pak owns
	  the screen. NextUI applies those keys in the list and in
	  Settings; this daemon is the msettings shm host and only
	  grabs gpio-keys-volume when nextui.elf is not running.

comment "zlyme-keylidmon needs the Miyoo Flip target and NextUI"
	depends on !BR2_ZLYME_DEVICE_MY355 || !BR2_PACKAGE_NEXTUI
```

## package/system/zlyme-maskrom/Config.in
```kconfig
config BR2_PACKAGE_ZLYME_MASKROM
	bool "zlyme maskrom restart"
	depends on BR2_ZLYME_DEVICE_MY355
	help
	  zlyme-maskrom syncs and requests restart2 command maskrom.
	  It does not erase the preloader.
```

## package/system/zlyme-preloader/Config.in
```kconfig
config BR2_PACKAGE_ZLYME_PRELOADER
	bool "zlyme preloader recovery"
	depends on BR2_ZLYME_DEVICE_MY355
	select BR2_PACKAGE_MTD
	select BR2_PACKAGE_MTD_FLASH_ERASE
	select BR2_PACKAGE_MTD_NANDWRITE
	select BR2_PACKAGE_MTD_MTDINFO
	select BR2_PACKAGE_PYTHON3
	help
	  Fail-closed preloader status, restore, and recovery for the Flip.
	  Settings calls the status and recovery commands. erase-preloader
	  is CLI-only. It does not run at boot.
```

## package/system/zlyme-usb-transfer/Config.in
```kconfig
config BR2_PACKAGE_ZLYME_USB_TRANSFER
	bool "zlyme usb file transfer"
	depends on BR2_ZLYME_DEVICE_MY355
	select BR2_PACKAGE_UMTPRD
	help
	  MTP session helper for the lower USB-C port. The Tools PAK
	  starts and stops it. It is not an init service.

comment "zlyme usb file transfer needs the my355 device"
	depends on !BR2_ZLYME_DEVICE_MY355
```
