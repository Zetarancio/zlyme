## package/system/cheat-downloader/Config.in
```kconfig
config BR2_PACKAGE_CHEAT_DOWNLOADER
	bool "cheat-downloader"
	depends on BR2_aarch64
	select BR2_PACKAGE_MINUI_LIST
	select BR2_PACKAGE_MINUI_PRESENTER
	select BR2_PACKAGE_SQLITE
	select BR2_PACKAGE_LIBCURL
	select BR2_PACKAGE_LIBCURL_CURL
	select BR2_PACKAGE_CA_CERTIFICATES
	help
	  Cheat Downloader v1.6.0. The Libretro database is user data
	  under /storage/.config/cheat-downloader. Installed .cht files
	  stay on the Cheats content path. Runtime needs libsqlite3,
	  the curl binary, and the system CA bundle.

	  https://github.com/nborodikhin/nextui-cheat-downloader-alt
```

## package/system/gl4es-armhf/Config.in
```kconfig
config BR2_PACKAGE_GL4ES_ARMHF
	bool "gl4es-armhf (isolated Box86 runtime)"
	depends on BR2_arm
	depends on BR2_ARM_EABIHF
	depends on BR2_PACKAGE_MESA3D_OPENGL_EGL
	depends on BR2_PACKAGE_MESA3D_OPENGL_ES
	depends on BR2_PACKAGE_MESA3D_GBM
	help
	  ARMHF GL4ES for explicit graphical Box86 launches. It uses
	  the ARMHF Mesa/Panfrost EGL/GLES provider and is installed
	  under /usr/lib/zlyme-armhf/gl4es only.

comment "gl4es-armhf needs ARMHF Mesa EGL, GLES, and GBM"
	depends on !BR2_arm || !BR2_ARM_EABIHF || \
		!BR2_PACKAGE_MESA3D_OPENGL_EGL || \
		!BR2_PACKAGE_MESA3D_OPENGL_ES || !BR2_PACKAGE_MESA3D_GBM
```

## package/system/gl4es/Config.in
```kconfig
config BR2_PACKAGE_GL4ES
	bool "gl4es (isolated PortMaster runtime)"
	depends on BR2_aarch64
	depends on BR2_PACKAGE_MESA3D_OPENGL_EGL
	depends on BR2_PACKAGE_MESA3D_OPENGL_ES
	help
	  OpenGL 2.1 compatibility over GLES 2, installed only under
	  /usr/lib/portmaster/gl4es/aarch64. The build follows the
	  ROCKNIX NOX11 and NOEGL profile. Ports must select it
	  explicitly; it does not replace system GL, EGL, or GLES.

	  https://github.com/ptitSeb/gl4es

comment "gl4es needs AArch64 Mesa EGL and GLES"
	depends on !BR2_aarch64 || !BR2_PACKAGE_MESA3D_OPENGL_EGL || \
		!BR2_PACKAGE_MESA3D_OPENGL_ES
```

## package/system/gpudriver/Config.in
```kconfig
config BR2_PACKAGE_GPUDRIVER
	bool "gpudriver"
	depends on BR2_PACKAGE_MALI_KBASE
	help
	  Boot-time switch between panfrost and mali_kbase. The
	  choice is /storage/.config/zlyme/gpu. A change needs a
	  reboot: both modules bind the same GPU.
```

## package/system/inputplumber/Config.in
```kconfig
config BR2_PACKAGE_INPUTPLUMBER
	bool "inputplumber"
	depends on BR2_PACKAGE_HOST_RUSTC_TARGET_ARCH_SUPPORTS
	select BR2_PACKAGE_HOST_RUSTC
	select BR2_PACKAGE_EUDEV
	select BR2_PACKAGE_LIBIIO
	select BR2_PACKAGE_DBUS
	help
	  InputPlumber v0.81.0. The daemon starts after NextUI's
	  first frame. auto_manage is false, so it manages no
	  controller until something asks it to.

	  https://github.com/ShadowBlip/InputPlumber

comment "inputplumber needs a Rust-supported target"
	depends on !BR2_PACKAGE_HOST_RUSTC_TARGET_ARCH_SUPPORTS
```

## package/system/libmali/Config.in
```kconfig
config BR2_PACKAGE_LIBMALI
	bool "libmali"
	depends on BR2_PACKAGE_MALI_KBASE
	select BR2_PACKAGE_LIBDRM
	help
	  ARM Mali Bifrost G52 user-space GLES (JeffyCN g29p1),
	  installed under /usr/lib/mali so it never replaces Mesa
	  filenames. gpudriver bind-mounts it when gpu=libmali.

	  https://github.com/JeffyCN/mirrors
```

## package/system/libportmidi/Config.in
```kconfig
config BR2_PACKAGE_LIBPORTMIDI
	bool "libportmidi"
	select BR2_PACKAGE_ALSA_LIB
	help
	  PortMidi MIDI I/O. Needed by Amiberry.

	  https://github.com/PortMidi/portmidi
```

## package/system/libudev-zero/Config.in
```kconfig
config BR2_PACKAGE_LIBUDEV_ZERO
	bool "libudev-zero"
	depends on !BR2_STATIC_LIBS
	depends on !BR2_PACKAGE_HAS_UDEV
	help
	  Daemonless replacement for libudev. Do not enable next to
	  eudev (both ship libudev.so). Zlyme uses eudev.

	  https://github.com/illiliti/libudev-zero

comment "libudev-zero needs a toolchain w/ dynamic library"
	depends on BR2_STATIC_LIBS
```

## package/system/mergerfs/Config.in
```kconfig
config BR2_PACKAGE_MERGERFS
	bool "mergerfs"
	depends on BR2_INSTALL_LIBSTDCPP
	help
	  FUSE union mount. Pools internal, SD2, and USB ROM folders
	  into /storage/Roms.

comment "mergerfs needs a toolchain with C++"
	depends on !BR2_INSTALL_LIBSTDCPP
```

## package/system/minui-list/Config.in
```kconfig
config BR2_PACKAGE_MINUI_LIST
	bool "minui-list"
	depends on BR2_PACKAGE_NEXTUI
	help
	  Scrollable list UI for NextUI/MinUI tool paks
	  (Artwork Scraper, Overlays, …).

	  Vendored snapshot of josegonzalez/minui-list 0.15.2
	  (MIT, Jose Diaz-Gonzalez). See UPSTREAM.
	  against Zlyme's NextUI SDK so fonts/assets come from
	  /usr/share/nextui/res. The linked NextUI objects stay
	  PolyForm Noncommercial 1.0.0 (originally MinUI by Shaun Inman).

	  https://github.com/josegonzalez/minui-list
	  NextUI: https://github.com/LoveRetro/NextUI
	  MinUI: https://github.com/shauninman/MinUI
```

## package/system/minui-presenter/Config.in
```kconfig
config BR2_PACKAGE_MINUI_PRESENTER
	bool "minui-presenter"
	depends on BR2_PACKAGE_NEXTUI
	select BR2_PACKAGE_MINUI_LIST
	help
	  Message/preview UI for NextUI/MinUI tool paks.

	  Vendored snapshot of josegonzalez/minui-presenter 0.13.2
	  (MIT, Jose Diaz-Gonzalez). See UPSTREAM.
	  against Zlyme's NextUI SDK so fonts/assets come from
	  /usr/share/nextui/res. The linked NextUI objects stay
	  PolyForm Noncommercial 1.0.0 (originally MinUI by Shaun Inman).

	  https://github.com/josegonzalez/minui-presenter
	  NextUI: https://github.com/LoveRetro/NextUI
	  MinUI: https://github.com/shauninman/MinUI
```

## package/system/music-player/Config.in
```kconfig
config BR2_PACKAGE_MUSIC_PLAYER
	bool "music-player"
	depends on BR2_aarch64
	select BR2_PACKAGE_FDK_AAC
	select BR2_PACKAGE_LIBZIP
	select BR2_PACKAGE_LIBSAMPLERATE
	select BR2_PACKAGE_ALSA_LIB
	help
	  Music Player v1.17.0. Local files under /storage/Music.
	  The in-app updater and cpufreq writes are not used.

	  https://github.com/nborodikhin/nextui-music-player
```

## package/system/nextui/Config.in
```kconfig
config BR2_PACKAGE_NEXTUI
	bool "nextui"
	depends on BR2_PACKAGE_HAS_LIBGLES
	select BR2_PACKAGE_SDL2
	select BR2_PACKAGE_SDL2_IMAGE
	select BR2_PACKAGE_SDL2_TTF
	select BR2_PACKAGE_LIBPNG
	select BR2_PACKAGE_FREETYPE
	select BR2_PACKAGE_ZLIB
	select BR2_PACKAGE_LIBSAMPLERATE
	select BR2_PACKAGE_OPENSSL
	select BR2_PACKAGE_LIBCURL
	select BR2_PACKAGE_ZSTD
	help
	  NextUI launcher (nextui.elf) and Settings, vendored from
	  LoveRetro/NextUI and edited in-tree for Zlyme. PLATFORM is
	  my355; SDCARD_PATH is /storage. Stock CFW skeleton is not used.

	  NextUI: https://github.com/LoveRetro/NextUI
	  Originally MinUI by Shaun Inman: https://github.com/shauninman/MinUI
	  License: PolyForm Noncommercial 1.0.0

comment "nextui needs GLES"
	depends on !BR2_PACKAGE_HAS_LIBGLES
```

## package/system/pico8-data-extractor/Config.in
```kconfig
config BR2_PACKAGE_PICO8_DATA_EXTRACTOR
	bool "pico8-data-extractor"
	depends on BR2_aarch64
	help
	  pico8-data-extractor 0.1.0. Prints PICO-8 cart Lua so
	  zlyme-pico-bbs can read a title. Static AArch64.

	  https://github.com/josegonzalez/pico8-data-extractor
```

## package/system/portmaster-rocknix-compat/Config.in
```kconfig
config BR2_PACKAGE_PORTMASTER_ROCKNIX_COMPAT
	bool "portmaster ROCKNIX compatibility libraries"
	depends on BR2_PACKAGE_XORG7
	depends on BR2_GCC_ENABLE_OPENMP
	select BR2_PACKAGE_PANGO
	select BR2_PACKAGE_SPEEX
	select BR2_PACKAGE_LIBGCRYPT
	select BR2_PACKAGE_LIBVDPAU
	select BR2_PACKAGE_XLIB_LIBX11
	select BR2_PACKAGE_XLIB_LIBXEXT
	select BR2_PACKAGE_XLIB_LIBXFIXES
	help
	  Legacy SONAMEs from the pinned ROCKNIX PortMaster compat
	  archive, installed only under /usr/lib/compat. System SDL2,
	  libxml2.so.2, and libtheoradec.so.1 are not replaced.

	  https://github.com/ROCKNIX/packages

comment "portmaster ROCKNIX compat needs X11 libraries and OpenMP"
	depends on !BR2_PACKAGE_XORG7 || !BR2_GCC_ENABLE_OPENMP
```

## package/system/portmaster-theora-compat/Config.in
```kconfig
config BR2_PACKAGE_PORTMASTER_THEORA_COMPAT
	bool "portmaster theora 1.1 compatibility"
	select BR2_PACKAGE_LIBOGG
	help
	  libtheora 1.1.1 decoder, installed only under /usr/lib/compat.
	  PortMaster LÖVE 11.5 was built against libtheoradec.so.1.
	  The system libtheora stays 1.2 (libtheoradec.so.2). This is
	  not a system Theora downgrade.

	  https://downloads.xiph.org/releases/theora/
```

## package/system/portmaster-xml2-compat/Config.in
```kconfig
config BR2_PACKAGE_PORTMASTER_XML2_COMPAT
	bool "portmaster libxml2 2.13 compatibility"
	select BR2_PACKAGE_ZLIB
	help
	  libxml2 2.13.9, installed only under /usr/lib/compat as
	  libxml2.so.2. X-Moto was built against that SONAME and the
	  LIBXML2_2.4.30 symbol version. The system libxml2 stays 2.15
	  (libxml2.so.16). This is not a symlink between those names.

	  https://download.gnome.org/sources/libxml2/2.13/
```

## package/system/portmaster/Config.in
```kconfig
config BR2_PACKAGE_PORTMASTER
	bool "portmaster"
	select BR2_PACKAGE_BOX64
	select BR2_PACKAGE_PYTHON3
	select BR2_PACKAGE_PYTHON3_PY_PYC
	select BR2_PACKAGE_PYTHON3_SSL
	select BR2_PACKAGE_PYTHON3_SQLITE
	select BR2_PACKAGE_PYTHON3_PYEXPAT
	select BR2_PACKAGE_PYTHON3_ZLIB
	select BR2_PACKAGE_CA_CERTIFICATES
	select BR2_PACKAGE_XZ
	help
	  PortMaster stable seed 2026.06.23-0015. The image keeps the
	  immutable seed /usr/share/portmaster/PortMaster.zip. First
	  launch unpacks the live tree on the selected library at
	  Roms/.portmaster/PortMaster. That library is authoritative.
	  Needs Python 3 (ssl, sqlite, xml), XZ, CA certificates, and
	  box64.

	  https://github.com/PortsMaster/PortMaster-GUI
```

## package/system/ruffle-handheld/Config.in
```kconfig
config BR2_PACKAGE_RUFFLE_HANDHELD
	bool "ruffle-handheld"
	depends on BR2_aarch64
	help
	  Ruffle Handheld v4.2, pinned release zip. No SWF games.
	  Launch glue is RUFFLE.pak. The runtime is not forked.

	  https://github.com/SilverPsychoo/Ruffle-Handheld
```

## package/system/scrapegoat/Config.in
```kconfig
config BR2_PACKAGE_SCRAPEGOAT
	bool "scrapegoat"
	depends on BR2_aarch64
	select BR2_PACKAGE_SDL2
	select BR2_PACKAGE_SDL2_TTF
	select BR2_PACKAGE_SDL2_IMAGE
	select BR2_PACKAGE_LIBCURL
	select BR2_PACKAGE_OPENSSL
	select BR2_PACKAGE_ZLIB
	help
	  ScrapeGoat v2.3.0. ScreenScraper artwork and Libretro cheats.
	  Private state is /storage/.config/ScrapeGoat. Artwork is written
	  beside the ROM. Installed cheats stay in /storage/Cheats.

	  https://github.com/Helaas/nextui-scrapegoat-pak
```

## package/system/syncthing/Config.in
```kconfig
config BR2_PACKAGE_SYNCTHING
	bool "syncthing"
	depends on BR2_aarch64
	help
	  Syncthing 2.0.13. Off at boot until zlyme-ctl set syncthing on.
	  GUI on :8384.

	  https://syncthing.net/
```

## package/system/zcrapegoat/Config.in
```kconfig
config BR2_PACKAGE_ZCRAPEGOAT
	bool "zcrapegoat"
	depends on BR2_aarch64
	select BR2_PACKAGE_SDL2
	select BR2_PACKAGE_SDL2_TTF
	select BR2_PACKAGE_SDL2_IMAGE
	select BR2_PACKAGE_LIBCURL
	select BR2_PACKAGE_OPENSSL
	select BR2_PACKAGE_ZLIB
	help
	  ZcrapeGoat v2.3.0. ScreenScraper artwork and Libretro cheats.
	  Private state is /storage/.config/ZcrapeGoat. Artwork is written
	  beside the ROM. Installed cheats stay in /storage/Cheats.

	  https://github.com/Helaas/nextui-scrapegoat-pak
```

## package/system/zlyme-armhf-probe/Config.in
```kconfig
config BR2_PACKAGE_ZLYME_ARMHF_PROBE
	bool "zlyme-armhf-probe"
	depends on BR2_arm
	depends on BR2_TOOLCHAIN_USES_GLIBC
	help
	  Small dynamically linked ARM EABI hard-float program. It is
	  the check that the ARMHF sysroot's loader and glibc match.
	  It is not installed in the AArch64 system image.

comment "zlyme-armhf-probe needs an ARM glibc toolchain"
	depends on !BR2_arm || !BR2_TOOLCHAIN_USES_GLIBC
```

## package/system/zlyme-armhf-runtime/Config.in
```kconfig
config BR2_PACKAGE_ZLYME_ARMHF_RUNTIME
	bool "zlyme-armhf-runtime"
	depends on BR2_aarch64
	help
	  ARM EABI hard-float loader and private glibc for 32-bit
	  programs. The files come from a sysroot already built with
	  configs/zlyme_my355_armhf_defconfig. This package does not
	  start that build. AArch64 libc is left in place.

comment "zlyme-armhf-runtime is installed into the AArch64 system"
	depends on !BR2_aarch64
```

## package/system/zlyme-artbook/Config.in
```kconfig
config BR2_PACKAGE_ZLYME_ARTBOOK
	bool "zlyme-artbook"
	help
	  Transparent system and Tool artwork composed on the build
	  host from Art Book Next. NextUI selects this package. The
	  finished PNGs are installed into the squashfs. Nothing is
	  fetched on the Flip.
```
